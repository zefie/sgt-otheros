## sgt-otheros-extras/Kconfig
```kconfig
menuconfig SGT_OTHEROS
	bool "SGT-OtherOS Extras"
	depends on MACH_SAMSUNG_P4WIFI || _MACH_SAMSUNG_P4
	default y
	---help---
	  SGT-OtherOS Extras provided by zefie

	  If in doubt, say Y here.


if SGT_OTHEROS
	
menuconfig SGT_MOUSEMODE
	bool "SGT-OtherOS Touchscreen MouseMode"
	default y
	---help---
	  Emulates a mouse using the touchscreen. When enabled, controls
	  are as follows:

		Light Touch: Move Mouse
		Hard Touch: Left Button Down (lift finger to release)
		Light Touch + 2nd Finger = Right Click @ 1st Finger
		3 Finger Tap = Toggle MouseMode

	  When mousemode is off, driver functions as a normal touchscreen,
	  Left Button is always down regardless of touch pressure.

if SGT_MOUSEMODE
config SGT_MOUSEMODE_DEFAULT
	bool "SGT-OtherOS Touchscreen MouseMode Default"
	default y
	---help---
	  Defaults to MouseMode. Set to N to default to standard touchscreen.


endif # SGT_MOUSEMODE

config SGT_DEBUG
	bool "SGT-OtherOS Debugging"
	default n
	---help---
	  Toggles some of zefie's added kernel debugging, mainly dumps
	  detailed information about hardware. You can safely disable
	  this if you are not interested in development.



source "sgt-otheros-extras/compcache-0.6.2/Kconfig"

endif # SGT_OTHEROS
```

## sgt-otheros-extras/compcache-0.6.2/Kconfig
```kconfig
config SGT_COMPCACHE
	tristate "compcache"
	depends on MODULES && m
	default m
	---help---
	  compcache creates RAM based block device (named ramzswap) which
          acts as swap disk. Pages swapped to this disk are compressed and
          stored in memory itself.

          Compressing pages and keeping them in RAM virtually increases its
          capacity. This allows more applications to fit in given amount of
          memory.
```
